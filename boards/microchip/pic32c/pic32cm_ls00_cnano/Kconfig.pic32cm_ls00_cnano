## boards/microchip/pic32c/pic32cm_ls00_cnano/Kconfig.pic32cm_ls00_cnano
```kconfig
# SPDX-License-Identifier: Apache-2.0

config BOARD_PIC32CM_LS00_CNANO
	def_bool y
	select SOC_PIC32CM5164LS00048
```
